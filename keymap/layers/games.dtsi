ZMK_LAYER(game_default,
// ╭──────────────────┬──────────────────┬──────────────────┬──────────────────┬──────────────────┬──────────────────╮   ╭──────────────────┬──────────────────┬──────────────────┬──────────────────┬──────────────────┬──────────────────╮
     &kp DEL            &kp LALT           &kp Q              &kp W              &kp E              &kp R                  ___                ___                ___                ___                ___                ___
// ├──────────────────├──────────────────┼──────────────────┼──────────────────┼──────────────────┼──────────────────┤   ├──────────────────├──────────────────┼──────────────────┼──────────────────┼──────────────────┼──────────────────┤
     &kp TAB            &kp LSHFT          &kp A              &kp S              &kp D              &kp F                  ___                &kp J              &kp K              &kp L              &kp SEMI           ___
// ├──────────────────├──────────────────┼──────────────────┼──────────────────┼──────────────────┼──────────────────┤   ├──────────────────├──────────────────┼──────────────────┼──────────────────┼──────────────────┼──────────────────┤
     ___                &kp Z              &kp X              &kp C              &kp V              &kp B                  ___                ___                ___                ___                ___                ___
// ╰──────────────────┴──────────────────┴──────────────────┼──────────────────┼──────────────────┼──────────────────┤   ├──────────────────├──────────────────┼──────────────────┼──────────────────┴──────────────────┴──────────────────╯
                                                              &kp LCTRL          &kp SPACE          &sl GAME_NUMPAD        &sl FN             &kp LCTRL          &kp LALT
//                                                          ╰──────────────────┴──────────────────┴──────────────────╯   ╰──────────────────┴──────────────────┴──────────────────╯
)

ZMK_LAYER(game_pro,
// ╭──────────────────┬──────────────────┬──────────────────┬──────────────────┬──────────────────┬──────────────────╮   ╭──────────────────┬──────────────────┬──────────────────┬──────────────────┬──────────────────┬──────────────────╮
     &kp BSPC           &kp LALT           &kp Q              &kp W              &kp E              &kp R                  ___                ___                ___                ___                ___                ___
// ├──────────────────├──────────────────┼──────────────────┼──────────────────┼──────────────────┼──────────────────┤   ├──────────────────├──────────────────┼──────────────────┼──────────────────┼──────────────────┼──────────────────┤
     &kp TAB            &kp LSHFT          &kp A              &kp S              &kp D              &kp F                  ___                &kp J              &kp K              &kp L              ___                ___
// ├──────────────────├──────────────────┼──────────────────┼──────────────────┼──────────────────┼──────────────────┤   ├──────────────────├──────────────────┼──────────────────┼──────────────────┼──────────────────┼──────────────────┤
     ___                &kp LCTRL          &kp Z              &kp X              &kp C              &kp V                  ___                ___                ___                ___                ___                ___
// ╰──────────────────┴──────────────────┴──────────────────┼──────────────────┼──────────────────┼──────────────────┤   ├──────────────────├──────────────────┼──────────────────┼──────────────────┴──────────────────┴──────────────────╯
                                                              &sl GAME_EXTRA     &kp SPACE          &sl GAME_NUMPAD        &sl FN             &kp LCTRL          &kp LALT
//                                                          ╰──────────────────┴──────────────────┴──────────────────╯   ╰──────────────────┴──────────────────┴──────────────────╯
)

ZMK_LAYER(game_extra,
// ╭──────────────────┬──────────────────┬──────────────────┬──────────────────┬──────────────────┬──────────────────╮   ╭──────────────────┬──────────────────┬──────────────────┬──────────────────┬──────────────────┬──────────────────╮
     ___                ___                &kp O              &kp I              &kp U              &kp Y                  ___                ___                ___                ___                ___                ___
// ├──────────────────├──────────────────┼──────────────────┼──────────────────┼──────────────────┼──────────────────┤   ├──────────────────├──────────────────┼──────────────────┼──────────────────┼──────────────────┼──────────────────┤
     ___                ___                &kp L              &kp K              &kp J              &kp H                  ___                ___                ___                ___                ___                ___
// ├──────────────────├──────────────────┼──────────────────┼──────────────────┼──────────────────┼──────────────────┤   ├──────────────────├──────────────────┼──────────────────┼──────────────────┼──────────────────┼──────────────────┤
     ___                ___                &kp P              &kp M              &kp N              &kp B                  ___                ___                ___                ___                ___                ___
// ╰──────────────────┴──────────────────┴──────────────────┼──────────────────┼──────────────────┼──────────────────┤   ├──────────────────├──────────────────┼──────────────────┼──────────────────┴──────────────────┴──────────────────╯
                                                              ___                ___                ___                    ___                ___                ___
//                                                          ╰──────────────────┴──────────────────┴──────────────────╯   ╰──────────────────┴──────────────────┴──────────────────╯
)

ZMK_LAYER(game_elden_ring,
// ╭──────────────────┬──────────────────┬──────────────────┬──────────────────┬──────────────────┬──────────────────╮   ╭──────────────────┬──────────────────┬──────────────────┬──────────────────┬──────────────────┬──────────────────╮
     &kp LA(TAB)        &kp Y              &kp Q              &kp W              &kp E              &kp R                  ___                ___                &kp UP             ___                ___                ___
// ├──────────────────├──────────────────┼──────────────────┼──────────────────┼──────────────────┼──────────────────┤   ├──────────────────├──────────────────┼──────────────────┼──────────────────┼──────────────────┼──────────────────┤
     ___                &kp N              &kp A              &kp S              &kp D              &kp F                  ___                &kp LEFT           &kp DOWN           &kp RIGHT          ___                ___
// ├──────────────────├──────────────────┼──────────────────┼──────────────────┼──────────────────┼──────────────────┤   ├──────────────────├──────────────────┼──────────────────┼──────────────────┼──────────────────┼──────────────────┤
     ___                &kp Z              &kp X              &kp C              &kp V              &kp B                  ___                ___                ___                ___                ___                ___
// ╰──────────────────┴──────────────────┴──────────────────┼──────────────────┼──────────────────┼──────────────────┤   ├──────────────────├──────────────────┼──────────────────┼──────────────────┴──────────────────┴──────────────────╯
                                                              &kp M              &kp SPACE          &kp J                  ___                &to ALPHA          ___
//                                                          ╰──────────────────┴──────────────────┴──────────────────╯   ╰──────────────────┴──────────────────┴──────────────────╯
)

ZMK_LAYER(game_numpad,
// ╭──────────────────┬──────────────────┬──────────────────┬──────────────────┬──────────────────┬──────────────────╮   ╭──────────────────┬──────────────────┬──────────────────┬──────────────────┬──────────────────┬──────────────────╮
     ___                ___                &kp N4             &kp N5             &kp N6             ___                    ___                ___                ___                ___                ___                ___
// ├──────────────────├──────────────────┼──────────────────┼──────────────────┼──────────────────┼──────────────────┤   ├──────────────────├──────────────────┼──────────────────┼──────────────────┼──────────────────┼──────────────────┤
     &kp LA(TAB)        &kp 0              &kp N1             &kp N2             &kp N3             ___                    ___                ___                ___                ___                ___                ___
// ├──────────────────├──────────────────┼──────────────────┼──────────────────┼──────────────────┼──────────────────┤   ├──────────────────├──────────────────┼──────────────────┼──────────────────┼──────────────────┼──────────────────┤
     ___                ___                &kp N7             &kp N8             &kp N9             ___                    ___                ___                ___                ___                ___                ___
// ╰──────────────────┴──────────────────┴──────────────────┼──────────────────┼──────────────────┼──────────────────┤   ├──────────────────├──────────────────┼──────────────────┼──────────────────┴──────────────────┴──────────────────╯
                                                              ___                ___                ___                    ___                ___                ___
//                                                          ╰──────────────────┴──────────────────┴──────────────────╯   ╰──────────────────┴──────────────────┴──────────────────╯
)
