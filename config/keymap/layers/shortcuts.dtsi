ZMK_LAYER(shortcuts,
// ╭──────────────────┬──────────────────┬──────────────────┬──────────────────┬──────────────────┬──────────────────╮   ╭──────────────────┬──────────────────┬──────────────────┬──────────────────┬──────────────────┬──────────────────╮
     ___                ___                &kp C_PREV         &kp C_NEXT         &kp C_PP           ___                    ___                PT_RULER           PT_EXTRACTOR       PT_RUN             ___                ___
// ├──────────────────├──────────────────┼──────────────────┼──────────────────┼──────────────────┼──────────────────┤   ├──────────────────├──────────────────┼──────────────────┼──────────────────┼──────────────────┼──────────────────┤
     ___                &kp LS(LG(PG_UP))  &kp LG(PG_UP)      &kp LG(PG_DN)      &kp LS(LG(PG_DN))  ___                    ___                ___                ___                ___                ___                ___
// ├──────────────────├──────────────────┼──────────────────┼──────────────────┼──────────────────┼──────────────────┤   ├──────────────────├──────────────────┼──────────────────┼──────────────────┼──────────────────┼──────────────────┤
     ___                ___                ___                ___                ___                ___                    ___                &kp LC(N0)         &kp LC(MINUS)      &kp LC(EQUAL)      ___                ___
// ╰──────────────────┴──────────────────┴──────────────────┼──────────────────┼──────────────────┼──────────────────┤   ├──────────────────├──────────────────┼──────────────────┼──────────────────┴──────────────────┴──────────────────╯
                                                              ___                ___                ___                    ___                ___                ___
//                                                          ╰──────────────────┴──────────────────┴──────────────────╯   ╰──────────────────┴──────────────────┴──────────────────╯
)
